## Kconfig
```kconfig
mainmenu "IMX6ULL SDK 配置"

menu "板级选择"
choice
	prompt "目标板"
	default SDK_BOARD_ALIENTEK_ALPHA_EMMC

	config SDK_BOARD_ALIENTEK_ALPHA_EMMC
		bool "正点原子 Alpha (i.MX6ULL, TF/EMMC)"
endchoice

config SDK_BOARD_NAME
	string
	default "imx6ull-alientek-alpha-emmc" if SDK_BOARD_ALIENTEK_ALPHA_EMMC
endmenu

menu "工具链"
config SDK_CROSS_PREFIX
	string "交叉工具链前缀（相对 SDK 根目录）"
	default "tools/gcc-11.3-bootlin/bin/arm-buildroot-linux-gnueabihf-"
	help
	  指到 bin/ 下的工具前缀（含结尾连字符）。
endmenu

menu "构建组件"
config SDK_BUILD_UBOOT
	bool "构建 U-Boot"
	default y
config SDK_BUILD_KERNEL
	bool "构建 Linux 内核"
	default y
config SDK_BUILD_ROOTFS
	bool "构建 Buildroot rootfs"
	default y
config SDK_INSTALL_MODULES
	bool "安装内核模块到 rootfs"
	default y
config SDK_MAKE_SDIMAGE
	bool "生成 sdcard.img（genimage 合成）"
	default y
config SDK_JOBS
	int "并行编译任务数"
	default 18
endmenu

menu "内核"
config SDK_KERNEL_DTB
	string "设备树名（不含 .dtb 后缀）"
	default "imx6ull-alientek-emmc"
endmenu
```

## board/imx6ull-alientek-alpha-emmc/buildroot_defconfig
```kconfig
BR2_arm=y
BR2_cortex_a7=y
BR2_TOOLCHAIN_EXTERNAL=y
BR2_TOOLCHAIN_EXTERNAL_CUSTOM=y
BR2_TOOLCHAIN_EXTERNAL_PATH="@SDK_TOOLS@"
BR2_TOOLCHAIN_EXTERNAL_CUSTOM_PREFIX="arm-buildroot-linux-gnueabihf"
BR2_TOOLCHAIN_EXTERNAL_GCC_11=y
BR2_TOOLCHAIN_EXTERNAL_HEADERS_4_9=y
BR2_TOOLCHAIN_EXTERNAL_CUSTOM_GLIBC=y
# BR2_TOOLCHAIN_EXTERNAL_INET_RPC is not set
BR2_TOOLCHAIN_EXTERNAL_CXX=y
BR2_PRIMARY_SITE="https://mirrors.tuna.tsinghua.edu.cn/buildroot"
BR2_TARGET_GENERIC_HOSTNAME="imx6ull"
BR2_TARGET_GENERIC_ISSUE="Welcome to IMX6ULL SDK"
BR2_SYSTEM_DHCP="eth0"
BR2_ROOTFS_OVERLAY="@BOARD_DIR@/rootfs-overlay"
BR2_ROOTFS_POST_BUILD_SCRIPT="@BOARD_DIR@/post-build.sh"
BR2_PACKAGE_BUSYBOX_CONFIG_FRAGMENT_FILES="@BOARD_DIR@/busybox-static.fragment"
BR2_PACKAGE_E2FSPROGS=y
BR2_PACKAGE_E2FSPROGS_RESIZE2FS=y
BR2_PACKAGE_UBOOT_TOOLS=y
BR2_PACKAGE_WPA_SUPPLICANT=y
BR2_PACKAGE_WPA_SUPPLICANT_CLI=y
BR2_PACKAGE_WPA_SUPPLICANT_PASSPHRASE=y
BR2_PACKAGE_HTOP=y
BR2_PACKAGE_UTIL_LINUX_BINARIES=y
BR2_PACKAGE_UTIL_LINUX_PARTX=y
BR2_TARGET_ROOTFS_EXT2=y
BR2_TARGET_ROOTFS_EXT2_4=y
BR2_TARGET_ROOTFS_EXT2_SIZE="128M"
BR2_TARGET_ROOTFS_SQUASHFS=y
BR2_PACKAGE_HOST_UBOOT_TOOLS=y
```

## board/imx6ull-alientek-alpha-emmc/sdk_defconfig
```kconfig
CONFIG_SDK_BOARD_ALIENTEK_ALPHA_EMMC=y
CONFIG_SDK_CROSS_PREFIX="tools/gcc-linaro-4.9.4-2017.01-x86_64_arm-linux-gnueabihf/bin/arm-linux-gnueabihf-"
CONFIG_SDK_BUILD_UBOOT=y
CONFIG_SDK_BUILD_KERNEL=y
CONFIG_SDK_BUILD_ROOTFS=y
CONFIG_SDK_INSTALL_MODULES=y
CONFIG_SDK_MAKE_SDIMAGE=y
CONFIG_SDK_JOBS=18
CONFIG_SDK_KERNEL_DTB="imx6ull-alientek-emmc"
```
